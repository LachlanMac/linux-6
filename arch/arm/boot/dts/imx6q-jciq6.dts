/*
 * The code contained herein is licensed under the GNU General Public
 * License. You may obtain a copy of the GNU General Public License
 * Version 2 or later at the following locations:
 * http://www.opensource.org/licenses/gpl-license.html
 * http://www.gnu.org/copyleft/gpl.html
 */
 
/dts-v1/;

#include "imx6q-core-jciq6.dtsi"
#include "imx6qdl-jciq6.dtsi"

/ {
	model = "JCI i.MX6Q Q6 Board";
	compatible = "fsl,imx6q-jciq6", "fsl,imx6q";

	memory {
        device_type = "memory";
		reg = <0x10000000 0xF0000000>;	/* reg = 0x10000000 base addr, 0xF0000000 size = 4GB */
	};
};
&sata {
	status = "okay";
};